#include <Arduino.h>
#include <Servo.h>
#include "hardware/adc.h"

#include <SPI.h>
#include <Wire.h>
#include <Adafruit_GFX.h>
#include <Adafruit_SSD1306.h>

#define SCREEN_WIDTH 128  // OLED display width, in pixels
#define SCREEN_HEIGHT 64  // OLED display height, in pixels

// Declaration for an SSD1306 display connected to I2C (SDA, SCL pins)
Adafruit_SSD1306 display(SCREEN_WIDTH, SCREEN_HEIGHT, &Wire, -1);


#define LOGO_HEIGHT   64
#define LOGO_WIDTH    128
  
const unsigned char startupimage [] PROGMEM = {
	// 'sunset bmp, 128x64px
	0x00, 0x00, 0x00, 0x00, 0x00, 0x00, 0x00, 0x00, 0x00, 0x00, 0x00, 0x00, 0x00, 0x00, 0x00, 0x00, 
	0x00, 0x00, 0x00, 0x00, 0x00, 0x00, 0x00, 0x07, 0xf8, 0x00, 0x00, 0x00, 0x00, 0x00, 0x00, 0x00, 
	0xc0, 0x00, 0x00, 0x00, 0x00, 0x00, 0x00, 0x1a, 0x7f, 0x00, 0x00, 0x00, 0x00, 0x00, 0x00, 0x00, 
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	0xff, 0xff, 0xff, 0xff, 0xff, 0xff, 0xff, 0xff, 0xff, 0xff, 0xff, 0xff, 0xff, 0xff, 0xff, 0xff
};

Servo myservo;  
//pin definitions
const int sonicPower = 21;
const int trigPin = 20;
const int echoPin = 19;
const int sonicGroundPin = 18;

const int servoPin = 15;

const int OLEDPowerPin = 6;

const int modePowerPin = 12;
const int modeInputPin = 10;


const int potPowerPin = 16;
const int potPin = A1;
const int potGroundPin = 17;

bool scanning=false;
bool ButtonState;

float duration, distance;
int mode = 0;
//press and unpress function definitions
void unpress(){
  myservo.writeMicroseconds(2000); 
  delay(100);
  myservo.writeMicroseconds(1500); 
}

void press(){
  myservo.writeMicroseconds(1000); 
  delay(120);
  myservo.writeMicroseconds(1500); 
}

void setup() {
  // Pin allocation
  myservo.attach(servoPin);  
  pinMode(trigPin, OUTPUT);
  pinMode(sonicPower, OUTPUT);
  pinMode(sonicGroundPin, OUTPUT);
  pinMode(echoPin, INPUT);
  
  pinMode(LED_BUILTIN, OUTPUT);
  pinMode(modeInputPin, INPUT);
  pinMode(potPowerPin, OUTPUT);
  pinMode(potGroundPin, OUTPUT);
  pinMode(potPin, INPUT);
  pinMode(OLEDPowerPin, OUTPUT);

  Serial.begin(9600);

  digitalWrite(sonicPower, HIGH);
  digitalWrite(sonicGroundPin, LOW);
  digitalWrite(LED_BUILTIN, HIGH);
  digitalWrite(modePowerPin, HIGH);
  digitalWrite(potPowerPin, HIGH);
  digitalWrite(potGroundPin, LOW);
  digitalWrite(OLEDPowerPin, HIGH);
  
  analogReadResolution(8);
  // Small delay to allow the display to power up
  delay(100);

  // Initialize I2C communication
  Wire.begin();

  // Initialize the OLED display with the I2C address 0x3C
  if(!display.begin(SSD1306_SWITCHCAPVCC, 0x3C)) {
    Serial.println(F("SSD1306 allocation failed"));
    for(;;);  // Infinite loop if display initialization fails
  }
  
  // Clear the buffer and display initialising screen

  display.clearDisplay();
  display.drawBitmap(
  (display.width()  - LOGO_WIDTH ) / 2,
  (display.height() - LOGO_HEIGHT) / 2,
  startupimage, LOGO_WIDTH, LOGO_HEIGHT, 1);
  display.setCursor(1, 10);
  display.setTextColor(BLACK); 
  display.println("\n\n\n\n\nInitialisieren...");
  display.setTextColor(WHITE); 
  display.display();

  //delay to ensure everything has booted properly
  delay(3000);
}

void loop() {
  //check if button pressed, if yes then check if held and switch to debug mode
  //if not then switch mode
  if(digitalRead(modeInputPin) == HIGH){
    display.clearDisplay();
    display.setCursor(0, 10);
    display.println("Halten Sie die Taste gedrueckt, um den \nDebug-Modus");
    display.display();
    delay(3000);
    if (digitalRead(modeInputPin)==HIGH)
    {
      mode = 2;
      display.clearDisplay();
      display.setCursor(0, 10);
      display.println("Wechsel in den Debug-Modus");
      display.display();
      delay(2000);
    }else{
      mode = (mode+1)%2;
    }
  
  }
  //get length measurement using time of flight 
  digitalWrite(trigPin, LOW);
  delayMicroseconds(2);
  digitalWrite(trigPin, HIGH);
  delayMicroseconds(10);
  digitalWrite(trigPin, LOW);

  duration = pulseIn(echoPin, HIGH);
  distance = (duration*.0343)/2;
  Serial.print("Distance: ");
  Serial.println(distance);
  Serial.println("\n");
  //delay to ensure no unnecessary repeated feedback from sensor
  delay(100);
  //if PCB not present and scanning is ongoing, stop scanning. double check to reduce flinching
  if(scanning && distance > 20){
    Serial.print("far\n");
    delay(100);
    if(distance>20){
        unpress();
        Serial.print("far confirmed\n");
        scanning = false;
    }
  //if PCB present and scanning not active, begin scanning
  }else if(distance<=20 && !scanning){
      Serial.print("close\n");
      scanning=true;
      press(); 
  //if scanning and in multimode, release and press button after chosen delay
  }else if(scanning && mode && distance<=20){
    delay(100+8*analogRead(potPin));
    unpress();
    press();
  }
  //serial feedback for debugging
  Serial.print("\n");
  Serial.print(digitalRead(modeInputPin));
  Serial.print("\n");

  //set cursor position and display correct message depending on mode
  display.setCursor(0, 10);

  display.clearDisplay();
  display.setTextSize(1);     
  display.setTextColor(WHITE); 

  display.setCursor(0, 10);

  switch (mode)
  {
  case 0:
    display.println("Einzel-Scan-Modus\n\n");
    
    break;
  case 1:
    display.println("Mehrfach-Scan-Modus\n");
    display.print("\nVerzoegerung: ");
    display.print(floor((8*analogRead(potPin)+100)/100)*100);
    display.print("\n\n");
    break;
  case 2:
    display.println("Debug-Modus");
    display.print("Distanz: ");
    display.print(distance);
    display.print("\n");
    
    display.print("Potentiometer: ");
    display.print(analogRead(potPin));
    display.print("\nVerzoegerung: ");
    display.print(floor((8*analogRead(potPin)+100)/100)*100);
    display.print("\n");
    break;
  }
  //display scanning status regardless of mode
  if (scanning)
  {
    display.println("wird gescannt");
  }else{
    display.println("bereit fur Scannen");
  }
  display.display();
}
